## network/aircrack-ng-hak5/Config.in
```kconfig
if PACKAGE_aircrack-ng-hak5

comment "SSL support"

choice
    prompt "Select SSL library"
    default AIRCRACK_NG_HAK5_OPENSSL

    config AIRCRACK_NG_HAK5_OPENSSL
        bool "openssl"

    config AIRCRACK_NG_HAK5_GCRYPT
        bool "gcrypt"
endchoice

config AIRCRACK_NG_HAK5_OPTIMIZE_SPEED
    bool "Optimize for speed"
    default n
    help
        This enables additional optimization and
        increases performance considerably at the
        expense of binary size.

comment "Miscellaneous"

config AIRCRACK_NG_HAK5_HWLOC
    bool "Hwloc support"
    default n

config AIRCRACK_NG_HAK5_SQLITE3
    bool "Sqlite3 support"
    default n

endif
```

## network/hostapd-mana/Config.in
```kconfig
config DRIVER_WEXT_SUPPORT
	bool
	default y

config DRIVER_11N_SUPPORT
        bool
        default y

config DRIVER_11AC_SUPPORT
        bool
        default y

config DRIVER_11W_SUPPORT
        bool
        default y

config DRIVER_TAXONOMY
        bool
        default y
```
